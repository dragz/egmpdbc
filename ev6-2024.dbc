VERSION ""

NS_ :

BS_:

BU_:

CM_ "FrameID: 0x475";
BO_ 1141 Passenger_Seat_Heating: 8 Vector__XXX
 SG_ Passenger_Seat_Heating_State : 0|8@1+ (1,0) [0|255] "" Vector__XXX

CM_ "FrameID: 0x496";
BO_ 1174 Driver_Seat_Heating: 8 Vector__XXX
 SG_ Driver_Seat_Heating_State : 0|8@1+ (1,0) [0|255] "" Vector__XXX

VAL_ 1141 Passenger_Seat_Heating_State 18 "Off" 50 "Low" 58 "Medium" 66 "High" ;
VAL_ 1174 Driver_Seat_Heating_State    18 "Off" 50 "Low" 58 "Medium" 66 "High" ;
